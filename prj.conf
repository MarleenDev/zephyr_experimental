## CMakeLists.txt
```
# SPDX-License-Identifier: Apache-2.0

cmake_minimum_required(VERSION 3.20.0)
find_package(Zephyr REQUIRED HINTS $ENV{ZEPHYR_BASE})
project(zephyr_experimental)

target_sources(app PRIVATE src/main.c src/leds.c src/buttons.c)
```

## sample.yaml
```
sample:
  name: mvos App Sample
tests:
  sample.basic.mvos_app:
    tags:
      - LED
      - gpio
    filter: dt_enabled_alias_with_parent_compat("led0", "gpio-leds")
    depends_on: gpio
    harness: led
    integration_platforms:
      - frdm_k64f
```

## prj.conf
```kconfig
CONFIG_GPIO=y
CONFIG_LED=y

CONFIG_STDOUT_CONSOLE=y
CONFIG_I2C=y
CONFIG_SENSOR=y
CONFIG_CBPRINTF_FP_SUPPORT=y
```

## src/main.c
```c
#include <zephyr/kernel.h>
#include <zephyr/drivers/gpio.h>
#include <zephyr/drivers/sensor.h>
#include <zephyr/device.h>
#include <zephyr/sys/util.h>

#include "buttons.h"
#include "leds.h"

#include <stdio.h>

#define U_SE_LPS22HH
#define U_SE_HTS221
#define SLEEP_TIME_MS 500

#ifdef USE_LPS22HH
const struct device* const lps22hh_dev = DEVICE_DT_GET_ONE(st_lps22hh);
#endif

#ifdef USE_HTS221
const struct device* const hts221_dev = DEVICE_DT_GET_ONE(st_hts221);
#endif

/**
 * DONE:
 *    Leds
 *    Button
 *    LPS22HH Pressure sensor, 260-1260 hPa absolute digital output barometer
 *    HTS221 Relative humidity and temperature sensor
 * TODO:
 *    usarts
 *    512-Mbit octal-SPI Flash memory, 64-Mbit octal-SPI PSRAM, 256-Kbit I2C EEPROM
 *    usb_fs
 *    wifi
 *    ble
 *    microphones
 *    2 digital microphones
 *    3-axis magnetometer
 *    3D accelerometer and 3D gyroscope
 *    Time-of-flight and gesture-detection sensor
 *    Ambient-light sensor
 *    DAC
 *    ADC
 *    pwm die temperature sensor
 */

#ifdef USE_LPS22HH
static void lps22hh_process_sample()
{
    static unsigned int obs;
    struct sensor_value pressure, temp;

    if (sensor_sample_fetch(lps22hh_dev) < 0) {
        printf("LPS22HH: sensor sample update error\n");
        return;
    }

    if (sensor_channel_get(lps22hh_dev, SENSOR_CHAN_PRESS, &pressure) < 0) {
        printf("LPS22H: cannot read pressure channel\n");
        return;
    }

    if (sensor_channel_get(lps22hh_dev, SENSOR_CHAN_AMBIENT_TEMP, &temp) < 0) {
        printf("LPS22HH: cannot read temperature channel\n");
        return;
    }

    ++obs;
    printf("Observation: %u\n", obs);
    printf("  Pressure: %.3f kPa\n", sensor_value_to_double(&pressure));
    printf("  Temperature: %.2f C\n", sensor_value_to_double(&temp));
}

static void lps22hh_handler(const struct device* dev, const struct sensor_trigger* trig)
{
    lps22hh_process_sample(dev);
}
#endif

#ifdef USE_HTS221
static void hts221_process_sample(const struct device* dev)
{
    static unsigned int obs;
    struct sensor_value temp, hum;
    if (sensor_sample_fetch(dev) < 0) {
        printf("HTS221: sensor sample update error\n");
        return;
    }

    if (sensor_channel_get(dev, SENSOR_CHAN_AMBIENT_TEMP, &temp) < 0) {
        printf("HTS221: cannot read temperature channel\n");
        return;
    }

    if (sensor_channel_get(dev, SENSOR_CHAN_HUMIDITY, &hum) < 0) {
        printf("HTS221: cannot read humidity channel\n");
        return;
    }

    ++obs;
    printf("Observation:%u\n", obs);
    printf("Temperature:%.1f C\n", sensor_value_to_double(&temp));
    printf("Relative Humidity:%.1f%%\n", sensor_value_to_double(&hum));
}

static void hts221_handler(const struct device* dev, const struct sensor_trigger* trig)
{
    hts221_process_sample(dev);
}
#endif

void button_pressed(const struct device *dev, struct gpio_callback *cb, uint32_t pins)
{
    printk("Button pressed at %" PRIu32 "\n", k_cycle_get_32());

    led_toggle(&LED_RED);

#ifdef USE_LPS22HH
    if (!IS_ENABLED(CONFIG_LPS22HH_TRIGGER)) {
        lps22hh_process_sample();
    }
#endif

#ifdef USE_HTS221
    if (!IS_ENABLED(CONFIG_HTS221_TRIGGER)) {
        hts221_process_sample(hts221_dev);
    }
#endif
}

bool board_init(void)
{
    // leds
    if (!led_init(&LED_GREEN, LED_OFF) || !led_init(&LED_RED, LED_OFF)) {
        return false;
    }

    // button
    if (!button_init(&BUTTON, button_pressed)) {
        return false;
    }

    // lps22hh
#ifdef USE_LPS22HH
    if (!device_is_ready(lps22hh_dev)) {
        printk("LPS22HH: sensor: device not ready.\n");
        return false;
    }
    if (IS_ENABLED(CONFIG_LPS22HH_TRIGGER)) {
        struct sensor_value attr = {
            .val1 = 1,
        };
        struct sensor_trigger trig = {
            .type = SENSOR_TRIG_DATA_READY,
            .chan = SENSOR_CHAN_ALL,
        };

        if (sensor_attr_set(lps22hh_dev, SENSOR_CHAN_ALL,
                            SENSOR_ATTR_SAMPLING_FREQUENCY, &attr) < 0) {
            printf("LPS22HH: cannot configure sampling rate\n");
            return false;
        }
        if (sensor_trigger_set(lps22hh_dev, &trig, lps22hh_handler) < 0) {
            printf("LPS22HH: cannot configure trigger\n");
            return false;
        }
        printk("Configured for triggered collection at %u Hz\n", attr.val1);
    }
#endif

#ifdef USE_HTS221
    // hts221
    if (!device_is_ready(hts221_dev)) {
        printk("HTS221: sensor: device not ready.\n");
        return false;
    }
    if (IS_ENABLED(CONFIG_HTS221_TRIGGER)) {
        struct sensor_trigger trig = {
            .type = SENSOR_TRIG_DATA_READY,
            .chan = SENSOR_CHAN_ALL,
        };
        if (sensor_trigger_set(hts221_dev, &trig, hts221_handler) < 0) {
            printf("HTS221: cannot configure trigger\n");
            return false;
        }
    }
#endif

    return true;
}

int main(void)
{
    if (!board_init()) {
        return -1;
    }

    while (1) {
        k_msleep(SLEEP_TIME_MS);
        led_toggle(&LED_GREEN);
    }

    return 0;
}
```

## src/buttons.c
```c
#include <zephyr/kernel.h>
#include "buttons.h"
#include <stdio.h>

#define SW0_NODE	DT_ALIAS(sw0)

const struct gpio_dt_spec BUTTON = GPIO_DT_SPEC_GET_OR(SW0_NODE, gpios, {0});
static struct gpio_callback button_cb_data;

bool button_init(const struct gpio_dt_spec* button, button_callback bcb)
{
    int ret = 0;

    if (!gpio_is_ready_dt(button)) {
        printf("Error: button device %s is not ready\n", button->port->name);
        return false;
    }

    ret = gpio_pin_configure_dt(button, GPIO_INPUT);
    if (ret != 0) {
        printf("Error %d: failed to configure %s pin %d\n", ret, button->port->name, button->pin);
        return false;
    }

    ret = gpio_pin_interrupt_configure_dt(button, GPIO_INT_EDGE_TO_ACTIVE);
    if (ret != 0) {
        printf("Error %d: failed to configure interrupt on %s pin %d\n", ret, button->port->name, button->pin);
        return false;
    }

    gpio_init_callback(&button_cb_data, bcb, BIT(button->pin));
    ret = gpio_add_callback(button->port, &button_cb_data);
    if (ret != 0) {
        printf("Error %d: failed to add button callback", ret); 
        return false;
    }

    printf("Set up button at %s pin %d\n", button->port->name, button->pin);
    return true;
}
```

## src/buttons.h
```c
#ifndef _BUTTONS_H_
#define _BUTTONS_H_
#include <zephyr/drivers/gpio.h>
#include <inttypes.h>
#include <stdbool.h>

extern const struct gpio_dt_spec BUTTON;

typedef void (*button_callback)(const struct device *, struct gpio_callback *, uint32_t);

bool button_init(const struct gpio_dt_spec* button, button_callback bcb);

#endif
```

## src/leds.c
```c
#include "leds.h"
#include <stdio.h>
#include <zephyr/drivers/gpio.h>

#define LED0_NODE DT_ALIAS(led0)
#define LED1_NODE DT_ALIAS(led1)

const struct gpio_dt_spec LED_GREEN = GPIO_DT_SPEC_GET(LED0_NODE, gpios);
const struct gpio_dt_spec LED_RED = GPIO_DT_SPEC_GET(LED1_NODE, gpios);

bool led_init(const struct gpio_dt_spec* led, bool on)
{
	if (!gpio_is_ready_dt(led)) {
        printf("Error: led GPIO not ready\n");
        return false;
	}
    int ret = gpio_pin_configure_dt(led, (on ? GPIO_OUTPUT_ACTIVE : GPIO_OUTPUT_INACTIVE));
    if (ret < 0) {
        printf("Error: gpio_pin_configure_dt returned %i\n", ret);
        return false;
    }
    return true;
}

bool led_toggle(const struct gpio_dt_spec* led)
{
    int ret = gpio_pin_toggle_dt(led);
    if (ret < 0) {
        printf("Error: gpio_pin_toggle_dt returned %i\n", ret);
        return false;
    }
    return true;
}

bool led_on(const struct gpio_dt_spec* led)
{
    int ret = gpio_pin_set_dt(led, 1);
    if (ret < 0) {
        printf("Error: gpio_pin_set_dt returned %i [led_on]\n]", ret);
        return false;
    }
    return true;
}

bool led_off(const struct gpio_dt_spec* led)
{
    int ret = gpio_pin_set_dt(led, 0);
    if (ret < 0) {
        printf("Error: gpio_pin_set_dt returned %i [led_off]\n", ret);
        return false;
    }
    return true;
}
```

## src/leds.h
```c
#ifndef _LEDS_H_
#define _LEDS_H_
#include <stdbool.h>

#define LED_ON true
#define LED_OFF false

extern const struct gpio_dt_spec LED_GREEN;
extern const struct gpio_dt_spec LED_RED;

bool led_init(const struct gpio_dt_spec* led, bool on);
bool led_toggle(const struct gpio_dt_spec* led);
bool led_on(const struct gpio_dt_spec* led);
bool led_off(const struct gpio_dt_spec* led);

#endif
```
